## components/vb6824/Kconfig
```kconfig
menu "VB6824 audio"
config VB6824_TYPE_OPUS_16K_20MS_PCM_16K
    bool
    default y
config VB6824_UART_PORT
    int
    default 1
config VB6824_UART_TASK_STACK_SIZE
    int
    default 4096
config VB6824_SEND_USE_TASK
    bool
    default y
config VB6824_SEND_TASK_STACK_SIZE
    int
    default 2048
endmenu
```

## examples/peripherals/main/Kconfig.projbuild
```kconfig
menu "micro-box-s3 peripherals"
choice MICRO_BOX_S3_DEMO
    prompt "Example"
    default MICRO_BOX_S3_DEMO_DISPLAY
config MICRO_BOX_S3_DEMO_DISPLAY
    bool "Dual display: RGB test"
config MICRO_BOX_S3_DEMO_AUDIO
    bool "Audio: tone and wake event"
config MICRO_BOX_S3_DEMO_CAMERA
    bool "Camera: capture to PSRAM"
config MICRO_BOX_S3_DEMO_TOUCH
    bool "Touch: GPIO11 single channel events"
config MICRO_BOX_S3_DEMO_BUTTONS
    bool "Buttons: GPIO12/13 events"
config MICRO_BOX_S3_DEMO_MOTOR
    bool "Motor: GPIO14 serial-triggered bounded pulses"
config MICRO_BOX_S3_DEMO_CONTROLS
    bool "Controls: one touch, two buttons, optional serial motor"
endchoice
endmenu
```

## examples/xiaozhi/main/Kconfig.projbuild
```kconfig
menu "micro-box-s3 Xiaozhi"

config BOARD_TYPE_MICRO_BOX_S3
    bool "micro-box-s3"
    depends on IDF_TARGET_ESP32S3
    default y
    select LCD_GC9A01_160X160
    select USE_EYE_STYLE_VB6824
    select USE_AUDIO_CODEC_ENCODE_OPUS

config LANGUAGE_ZH_CN
    bool
    default y

config USE_SOFTAP_NET_CONFIGURING
    bool
    default y

config USE_EYE_STYLE_VB6824
    bool
    default y

config USE_AUDIO_CODEC_ENCODE_OPUS
    bool
    default y

config USE_AUDIO_CODEC_DECODE_OPUS
    bool
    depends on n
    default n

config VB6824_OTA_SUPPORT
    bool
    depends on n
    default n
    help
        Not available: this example uses the UART-only VB6824 component.

config OTA_URL
    string "Xiaozhi activation and service-discovery URL"
    default "https://api.tenclass.net/xiaozhi/ota/"
    help
        Xiaozhi protocol service discovery, activation and ESP32 application OTA.
        This is unrelated to the disabled UART codec upgrade functionality.

choice IOT_PROTOCOL
    prompt "IoT protocol"
    default IOT_PROTOCOL_MCP
config IOT_PROTOCOL_MCP
    bool "MCP 2024-11-05 with vision tools"
config IOT_PROTOCOL_XIAOZHI
    bool "Xiaozhi IoT 1.0"
endchoice

config USE_DEVICE_AEC
    bool "Use the codec's device-side AEC"
    default n

config USE_SERVER_AEC
    bool "Use server-side AEC"
    default n

config USE_AUDIO_DEBUGGER
    bool "Enable audio UDP diagnostics"
    default n
config AUDIO_DEBUG_UDP_SERVER
    string "Audio diagnostic UDP address"
    default "127.0.0.1:8000"
    depends on USE_AUDIO_DEBUGGER

config SPEAKING_FIRST_MUTE_TIME
    int "Mute duration before speaking (ms)"
    default 60
config TACKGROUND_TASK_STACK_SIZE
    int "Background task stack size (bytes)"
    default 28672
config AUDIO_LOOP_TASK_STACK_SIZE
    int "Audio task stack size (bytes)"
    default 8192
endmenu
```

## examples/xiaozhi/sdkconfig.defaults
```kconfig
# Fixed hardware and language contract; do not reuse a previous sdkconfig.
CONFIG_IDF_TARGET="esp32s3"
CONFIG_BOARD_TYPE_MICRO_BOX_S3=y
CONFIG_LCD_GC9A01_160X160=y
CONFIG_USE_EYE_STYLE_VB6824=y
CONFIG_LANGUAGE_ZH_CN=y
CONFIG_USE_SOFTAP_NET_CONFIGURING=y
CONFIG_USE_AUDIO_CODEC_ENCODE_OPUS=y
# CONFIG_USE_AUDIO_CODEC_DECODE_OPUS is not set
# CONFIG_VB6824_OTA_SUPPORT is not set
CONFIG_IOT_PROTOCOL_MCP=y
# CONFIG_USE_DEVICE_AEC is not set
# CONFIG_USE_SERVER_AEC is not set
CONFIG_TACKGROUND_TASK_STACK_SIZE=28672
CONFIG_AUDIO_LOOP_TASK_STACK_SIZE=8192

CONFIG_ESPTOOLPY_FLASHSIZE_16MB=y
CONFIG_ESPTOOLPY_FLASHMODE_QIO=y
CONFIG_ESPTOOLPY_FLASHFREQ_80M=y
CONFIG_ESP_DEFAULT_CPU_FREQ_MHZ_240=y
CONFIG_SPIRAM=y
CONFIG_SPIRAM_MODE_OCT=y
CONFIG_SPIRAM_SPEED_80M=y
CONFIG_SPIRAM_USE_MALLOC=y
CONFIG_SPIRAM_MALLOC_ALWAYSINTERNAL=4096
CONFIG_SPIRAM_MALLOC_RESERVE_INTERNAL=49152
# CONFIG_SPIRAM_MEMTEST is not set
CONFIG_MBEDTLS_EXTERNAL_MEM_ALLOC=y
CONFIG_ESP32S3_INSTRUCTION_CACHE_32KB=y
CONFIG_ESP32S3_DATA_CACHE_64KB=y
CONFIG_ESP32S3_DATA_CACHE_LINE_64B=y
CONFIG_OV3660_SUPPORT=y

CONFIG_COMPILER_CXX_EXCEPTIONS=y
CONFIG_COMPILER_CXX_EXCEPTIONS_EMG_POOL_SIZE=1024
CONFIG_COMPILER_OPTIMIZATION_SIZE=y
CONFIG_BOOTLOADER_COMPILER_OPTIMIZATION_PERF=y
CONFIG_BOOTLOADER_APP_ROLLBACK_ENABLE=y
CONFIG_PARTITION_TABLE_CUSTOM=y
CONFIG_PARTITION_TABLE_CUSTOM_FILENAME="partitions.csv"
CONFIG_PARTITION_TABLE_OFFSET=0x8000
CONFIG_ESP_TASK_WDT_TIMEOUT_S=10
CONFIG_ESP_MAIN_TASK_STACK_SIZE=8192
CONFIG_ESP_SYSTEM_EVENT_TASK_STACK_SIZE=4096
CONFIG_HTTPD_MAX_REQ_HDR_LEN=2048
CONFIG_HTTPD_MAX_URI_LEN=2048
CONFIG_FREERTOS_HZ=1000
CONFIG_FREERTOS_GENERATE_RUN_TIME_STATS=y
CONFIG_FREERTOS_USE_STATS_FORMATTING_FUNCTIONS=y
CONFIG_UART_ISR_IN_IRAM=y
# CONFIG_ESP_WIFI_IRAM_OPT is not set
# CONFIG_ESP_WIFI_RX_IRAM_OPT is not set
CONFIG_ESP_WIFI_DYNAMIC_RX_MGMT_BUFFER=y
CONFIG_ESP_WIFI_STATIC_RX_BUFFER_NUM=6
CONFIG_ESP_WIFI_DYNAMIC_RX_BUFFER_NUM=8
# CONFIG_ESP_WIFI_ENTERPRISE_SUPPORT is not set
CONFIG_MBEDTLS_DYNAMIC_BUFFER=y
# CONFIG_MBEDTLS_SSL_KEEP_PEER_CERTIFICATE is not set
CONFIG_NEWLIB_NANO_FORMAT=y

CONFIG_LV_OS_NONE=y
CONFIG_LV_USE_CLIB_MALLOC=y
CONFIG_LV_USE_CLIB_STRING=y
CONFIG_LV_USE_CLIB_SPRINTF=y
CONFIG_LV_USE_IMGFONT=y
CONFIG_LV_FONT_FMT_TXT_LARGE=y
CONFIG_LV_USE_FONT_COMPRESSED=y
CONFIG_LV_USE_FONT_PLACEHOLDER=y
# CONFIG_LV_BUILD_EXAMPLES is not set
# CONFIG_LV_BUILD_DEMOS is not set
```
